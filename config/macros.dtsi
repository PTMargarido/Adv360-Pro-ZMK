macro_switch4: macro_switch4{
compatible = "zmk,behavior-macro";
label = "macro_switch4";
#binding-cells = <0>;
bindings = <&sk LEFT_ALT>, <&kp N4>;
};
macro_switch3: macro_switch3{
compatible = "zmk,behavior-macro";
label = "macro_switch3";
#binding-cells = <0>;
bindings = <&sk LEFT_ALT>, <&kp N3>;
};
macro_switch2: macro_switch2{
compatible = "zmk,behavior-macro";
label = "macro_switch2";
#binding-cells = <0>;
bindings = <&sk LEFT_ALT>, <&kp N2>;
};
macro_switch1: macro_switch1{
compatible = "zmk,behavior-macro";
label = "macro_switch1";
#binding-cells = <0>;
bindings = <&sk LEFT_ALT>, <&kp N1>;
};